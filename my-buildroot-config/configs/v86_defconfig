## my-buildroot-config/configs/v86_defconfig
```kconfig
BR2_x86_pentium_m=y
BR2_TOOLCHAIN_BUILDROOT_MUSL=y
BR2_CCACHE=y
BR2_TARGET_GENERIC_GETTY_OPTIONS="-n"
BR2_ROOTFS_POST_BUILD_SCRIPT="$(BR2_EXTERNAL_v86_PATH)/board/v86/post_build.sh"
BR2_LINUX_KERNEL=y
BR2_LINUX_KERNEL_USE_CUSTOM_CONFIG=y
BR2_LINUX_KERNEL_CUSTOM_CONFIG_FILE="$(BR2_EXTERNAL_v86_PATH)/board/v86/linux.config"
BR2_PACKAGE_GIT=y
BR2_PACKAGE_KBD=y
BR2_TARGET_ROOTFS_ISO9660=y
BR2_TARGET_SYSLINUX=y
BR2_PACKAGE_HOST_E2FSPROGS=y
```
